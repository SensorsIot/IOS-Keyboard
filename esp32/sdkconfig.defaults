## esp32/sdkconfig.defaults
```kconfig
# IOS-Keyboard ESP-IDF Configuration

# Flash size (4MB)
CONFIG_ESPTOOLPY_FLASHSIZE_4MB=y
CONFIG_ESPTOOLPY_FLASHSIZE="4MB"

# Partition Table
CONFIG_PARTITION_TABLE_CUSTOM=y
CONFIG_PARTITION_TABLE_CUSTOM_FILENAME="partitions.csv"

# HTTP Server
CONFIG_HTTPD_MAX_REQ_HDR_LEN=1024
CONFIG_HTTPD_MAX_URI_LEN=512

# WiFi - disable power save for faster OTA
CONFIG_ESP_WIFI_SOFTAP_SUPPORT=y
CONFIG_ESP_WIFI_STA_DISCONNECTED_PM_ENABLE=n

# OTA
CONFIG_BOOTLOADER_APP_ROLLBACK_ENABLE=y

# Log Level - Info for normal operation
CONFIG_LOG_DEFAULT_LEVEL_INFO=y
CONFIG_LOG_DEFAULT_LEVEL=3
CONFIG_LOG_MAXIMUM_LEVEL=4

# HTTPS OTA (allow HTTP for testing)
CONFIG_ESP_HTTPS_OTA_ALLOW_HTTP=y

# Console output via UART (USB used for HID on S3)
CONFIG_ESP_CONSOLE_UART_DEFAULT=y
CONFIG_ESP_CONSOLE_SECONDARY_USB_SERIAL_JTAG=y

# Early boot logging
CONFIG_BOOTLOADER_LOG_LEVEL_INFO=y
CONFIG_BOOTLOADER_LOG_LEVEL=3

# TinyUSB for HID keyboard
CONFIG_TINYUSB_HID_COUNT=1

# Memory optimization
CONFIG_COMPILER_OPTIMIZATION_SIZE=y

# mDNS
CONFIG_MDNS_MAX_SERVICES=10

# Bluetooth - NimBLE for BLE GATT
CONFIG_BT_ENABLED=y
CONFIG_BT_NIMBLE_ENABLED=y
CONFIG_BT_CONTROLLER_ENABLED=y

# Faster OTA - max TCP buffers
CONFIG_LWIP_TCP_SND_BUF_DEFAULT=65535
CONFIG_LWIP_TCP_WND_DEFAULT=65535
CONFIG_LWIP_TCP_RECVMBOX_SIZE=32

# HTTP client buffer for OTA
CONFIG_ESP_HTTP_CLIENT_ENABLE_HTTPS=n
CONFIG_ESP_HTTP_CLIENT_ENABLE_BASIC_AUTH=n
```

## sdkconfig.defaults
```kconfig
# IOS-Keyboard ESP-IDF Configuration

# Flash size (4MB)
CONFIG_ESPTOOLPY_FLASHSIZE_4MB=y
CONFIG_ESPTOOLPY_FLASHSIZE="4MB"

# Partition Table
CONFIG_PARTITION_TABLE_CUSTOM=y
CONFIG_PARTITION_TABLE_CUSTOM_FILENAME="partitions.csv"

# HTTP Server
CONFIG_HTTPD_MAX_REQ_HDR_LEN=1024
CONFIG_HTTPD_MAX_URI_LEN=512

# WiFi
CONFIG_ESP_WIFI_SOFTAP_SUPPORT=y

# OTA
CONFIG_BOOTLOADER_APP_ROLLBACK_ENABLE=y

# Log Level
CONFIG_LOG_DEFAULT_LEVEL_INFO=y
CONFIG_LOG_DEFAULT_LEVEL=3

# HTTPS OTA (allow HTTP for testing)
CONFIG_ESP_HTTPS_OTA_ALLOW_HTTP=y

# Console output via USB CDC
CONFIG_ESP_CONSOLE_USB_CDC=y
CONFIG_ESP_CONSOLE_SECONDARY_NONE=y

# USB CDC on boot
CONFIG_ESP_CONSOLE_USB_CDC_RX_BUF_SIZE=256
CONFIG_ESP_CONSOLE_USB_CDC_SUPPORT_ETS_PRINTF=y

# Memory optimization
CONFIG_COMPILER_OPTIMIZATION_SIZE=y

# mDNS
CONFIG_MDNS_MAX_SERVICES=10
```
